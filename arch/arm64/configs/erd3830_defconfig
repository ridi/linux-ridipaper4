## arch/arm64/configs/erd3830_defconfig
```kconfig
#
# ERD3830 board specific configuration
#

CONFIG_SCSC_WLBT_CONFIG_PLATFORM="nacho_s612_erd"
CONFIG_SND_SOC_SAMSUNG_EXYNOS3830_SOUND=y
#CONFIG_NFC=y
#CONFIG_SEC_NFC=y
#CONFIG_SEC_NFC_PRODUCT_N5=y
#CONFIG_SEC_NFC_IF_I2C=y
#CONFIG_SEC_NFC_GPIO_CLK=y
#CONFIG_SEC_NFC_LDO_EN=y
# CONFIG_CAMERA_CIS_4H5YC_OBJ is not set
# CONFIG_CAMERA_CIS_5E9_OBJ is not set
# CONFIG_CAMERA_CIS_GM1SP_OBJ is not set
# CONFIG_CAMERA_ACT_DW9839_OBJ is not set
# CONFIG_CAMERA_FLASH_S2MU106_OBJ is not set
CONFIG_CAMERA_CIS_3L6_OBJ=y
CONFIG_CAMERA_ACT_DW9763_OBJ=y
```

## arch/arm64/configs/smdk3830_defconfig
```kconfig
#
# SMDK3830 board specific configuration
#
CONFIG_FAKE_BATT=y
CONFIG_SCSC_WLBT_CONFIG_PLATFORM="nacho_s612_smdk"
```

## drivers/ccic/Kconfig
```kconfig
#
# CCIC devices
#

comment "CCIC configs"

config USE_CCIC
	bool "Using USBPD device driver"
	depends on I2C
	default n
	help
	  If you say yes here you will get support for
	  the USB PD(Power Delivery) device driver.

config CCIC_S2MU107
	bool "Using S2MU107 USB PD"
	depends on USE_CCIC
	default n
	help
	  If you say yes here you will get support for
	  for the S2MU107 USBPD chip.

config CCIC_S2MU106
	bool "Using S2MU106 USB PD"
	depends on USE_CCIC
	default n
	help
	  If you say yes here you will get support for
	  for the S2MU106 USBPD chip.

config CCIC_SYSFS
	bool "Using CCIC SYSFS System"
	depends on USE_CCIC
	default n
	help
	  If you say yes here you will get support for
	  sysfs system.

config PDIC_DP
	bool "Support DisplayPort"
	depends on USE_CCIC
	default n
	help
	  If you say yes here you will get support for
	  DisplayPort
```

## drivers/gud/Kconfig
```kconfig
#
# Mobicore Configuration
#
if SOC_EXYNOS9610
source "drivers/gud/gud-exynos9610/Kconfig"
endif

if SOC_EXYNOS9630
source "drivers/gud/gud-exynos9630/Kconfig"
endif

if SOC_EXYNOS3830
source "drivers/gud/gud-exynos3830/Kconfig"
endif
```

## drivers/input/touchscreen/gslX680/Kconfig
```kconfig
#
# GSL gslX680 Touchscreen driver
#
config TOUCHSCREEN_GSLX680
	bool "Goodix touchpanel gslX680 series"
	depends on I2C
	help
	  Say Y here if you have a GSL gslX680 touchscreen
	  controller.

          If unsure, say N.
```

## drivers/media/platform/exynos/camera/ischain/Kconfig
```kconfig
config EXYNOS_PABLO_ISP
	bool "Use Chain driver"
	depends on VIDEO_EXYNOS_PABLO_ISP
	default y
	help
	  This config abstracts driver source folder.

choice
	prompt "Select Pablo HW Version"
	depends on EXYNOS_PABLO_ISP
	help
	  Select Pablo ISP Version.

source "drivers/media/platform/exynos/camera/ischain/is-v7_0_0/Kconfig"
source "drivers/media/platform/exynos/camera/ischain/is-v8_10_0/Kconfig"
source "drivers/media/platform/exynos/camera/ischain/is-v8_20_0/Kconfig"

endchoice
```

## drivers/ridi/Kconfig
```kconfig
#
# RP-400 drivers
#

config MACH_RP400
	bool "RP400 board"
	help
	  Select RP400 base board.

config RP400_HW_REV_WS
	bool "RP400 WS board"
	depends on MACH_RP400
	help
	  Select RP400 WS board.

config RP400_MISC
	bool "RP-400 misc driver"
	help
	  Enable this driver will support RP-400 misc driver.

config ITE_IT8951
	bool "E-ink Panel Controller"
	help
	  Enable this driver will support E-ink Panel.

config ROHM_BU52072GWZ
	bool "ROHM Omnipolar Detection Hall IC"
	help
	  Enable this driver will support Hall IC.
```

## drivers/video/fbdev/exynos/Kconfig
```kconfig
if SOC_EXYNOS9630 || SOC_EXYNOS9830 || SOC_EXYNOS3830

source "drivers/video/fbdev/exynos/dpu30/Kconfig"

endif # SOC_EXYNOS9630 || SOC_EXYNOS9830 || SOC_EXYNOS3830
```
